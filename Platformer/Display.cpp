// author: chris-scientist
// created at: 29/01/2019
// updated at: 09/02/2019

#include "Display.h"

// **************************************************************************
// Images

// Fond du jeu
const uint16_t backgroundData[] = {80,64,1, 0, 0, 0, 0x7ddf,0x7ddf,0x7ddf,0x7ddf,0x7ddf,0x7ddf,0x7ddf,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0x210,0x4439};
Image background(backgroundData);

// --------------------------------------------------------------------------
// Personnage

// Personnage droite 1
const uint16_t heroD1Data[] = {8,13,1, 0, 0xca30, 0, 0xca30,0xca30,0xfd42,0xfd42,0xfd42,0xca30,0xca30,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0xca30,0xca30};
Image heroD1(heroD1Data);

// Personnage droite 2
const uint16_t heroD2Data[] = {8,13,1, 0, 0xca30, 0, 0xca30,0xca30,0xca30,0xca30,0xca30,0xca30,0xca30,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0xdaa5,0xca30};
Image heroD2(heroD2Data);

// Personnage gauche 1
const uint16_t heroG1Data[] = {8,13,1, 0, 0xca30, 0, 0xca30,0xca30,0xca30,0xfd42,0xfd42,0xfd42,0xca30,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0xca30,0xca30};
Image heroG1(heroG1Data);

// Personnage gauche 2
const uint16_t heroG2Data[] = {8,13,1, 0, 0xca30, 0, 0xca30,0xca30,0xca30,0xca30,0xca30,0xca30,0xca30,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0xe2e2,0xe2e2};
Image heroG2(heroG2Data);

// Personnage droite 1 avec clé
const uint16_t heroD1KData[] = {8,13,1, 0, 0xca30, 0, 0xca30,0xfd42,0xfd42,0xfd42,0xca30,0xca30,0xca30,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0xca30,0xca30};
Image heroD1K(heroD1KData);

// Personnage droite 2 avec clé
const uint16_t heroD2KData[] = {8,13,1, 0, 0xca30, 0, 0xca30,0xca30,0xca30,0xca30,0xca30,0xca30,0xca30,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0xe2e2,0xe302};
Image heroD2K(heroD2KData);

// Personnage gauche 1 avec clé
const uint16_t heroG1KData[] = {8,13,1, 0, 0xca30, 0, 0xca30,0xca30,0xca30,0xca30,0xfd42,0xfd42,0xfd42,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0x0,0xca30};
Image heroG1K(heroG1KData);

// Personnage gauche 2 avec clé
const uint16_t heroG2KData[] = {8,13,1, 0, 0xca30, 0, 0xca30,0xca30,0xca30,0xca30,0xca30,0xca30,0xca30,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0xca30,0xe302};
Image heroG2K(heroG2KData);

// --------------------------------------------------------------------------
// Plateformes

// -------------------------------------------------------------------------- //
// Plateforme                                                                 //
// -------------------------------------------------------------------------- //

// Plateforme gauche
const uint16_t platformLeftData[] = {8,8,1, 0, 0xca30, 0, 0xca30,0xca30,0x5268,0x5268,0x5268,0x5268,0x5268,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0x0,0x0};
Image platformLeft(platformLeftData);

// Plateforme milieu
const uint16_t platformMiddleData[] = {8,8,1, 0, 0, 0, 0x5268,0x5268,0x5268,0x5268,0x5268,0x5268,0x5268,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0x0,0x0};
Image platformMiddle(platformMiddleData);

// Plateforme droite
const uint16_t platformRightData[] = {8,8,1, 0, 0xca30, 0, 0x5268,0x5268,0x5268,0x5268,0x5268,0x5268,0xca30,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0xca30,0xca30};
Image platformRight(platformRightData);

// -------------------------------------------------------------------------- //
// Colline                                                                    //
// -------------------------------------------------------------------------- //

// Colline gauche
const uint16_t hillLeftData[] = {8,16,1, 0, 0xca30, 0, 0xca30,0x0,0x0,0x0,0x0,0x0,0x0,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0x44a,0x44a};
Image hillLeft(hillLeftData);

// Colline milieu 1
const uint16_t hillMiddle1Data[] = {8,16,1, 0, 0xca30, 0, 0x0,0x0,0x0,0x0,0x0,0x0,0x0,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0x44a,0x44a};
Image hillMiddle1(hillMiddle1Data);

// Colline milieu 2
const uint16_t hillMiddle2Data[] = {8,16,1, 0, 0xca30, 0, 0x0,0x0,0x0,0x0,0x0,0x0,0x0,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0x44a,0x44a};
Image hillMiddle2(hillMiddle2Data);

// Colline droite
const uint16_t hillRightData[] = {8,16,1, 0, 0xca30, 0, 0x0,0x0,0x0,0x0,0x0,0x0,0x0,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0x44a,0xca30};
Image hillRight(hillRightData);

// -------------------------------------------------------------------------- //
// Sol                                                                        //
// -------------------------------------------------------------------------- //

// Sol 1
const uint16_t ground1Data[] = {8,10,1, 0, 0, 0, 0x0,0x0,0x0,0x0,0x0,0x0,0x0,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0x44a,0x44a};
Image ground1(ground1Data);

// Sol 2
const uint16_t ground2Data[] = {8,10,1, 0, 0, 0, 0x0,0x0,0x0,0x0,0x0,0x0,0x0,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0x44a,0x44a};
Image ground2(ground2Data);

// Sol 3
const uint16_t ground3Data[] = {8,10,1, 0, 0, 0, 0x0,0x0,0x0,0x0,0x0,0x0,0x0,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0x44a,0x44a};
Image ground3(ground3Data);

// --------------------------------------------------------------------------
// Personnage

// Clé
const uint16_t keyData[] = {10,7,1, 0, 0xca30, 0, 0xca30,0xca30,0xca30,0xca30,0xca30,0xca30,0xca30,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0xca30,0xca30};
Image key(keyData);

// -------------------------------------------------------------------------- //
// Porte                                                                      //
// -------------------------------------------------------------------------- //

// Porte fermé
const uint16_t doorClosedData[] = {10,12,1, 0, 0xca30, 0, 0xca30,0xca30,0xca30,0x5980,0x5980,0x5980,0x5980,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0x5980,0x5980};
Image doorClosed(doorClosedData);

// Porte entre-ouverte
const uint16_t doorBtwOpenData[] = {10,12,1, 0, 0xca30, 0, 0xca30,0xca30,0xca30,0x5980,0x5980,0x5980,0x5980,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0x5980,0x5980};
Image doorBtwOpen(doorBtwOpenData);

// Porte ouverte
const uint16_t doorOpenData[] = {10,12,1, 0, 0, 0, 0xca30,0xca30,0xca30,0x5980,0x5980,0x5980,0x5980,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0x5980,0x5980};
Image doorOpen(doorOpenData);


// **************************************************************************
// Code

char * paintInputPseudoWindow() {
  char pseudo[6] = "    ";

  gb.gui.keyboard("Your pseudo", pseudo);
  gb.display.clear();

  return pseudo;
}

const int paintHomeScreen() {
  const char* items[] = {
    PLAY_FR,
    HIGH_SCORE_FR
  };

  const uint8_t indexItem = gb.gui.menu("Menu", items);
  int choice = HOME_STATE;
  if(items[indexItem] == PLAY_FR) {
    choice = LAUNCH_PLAY_STATE;
  } else if(items[indexItem] == HIGH_SCORE_FR) {
    choice = HIGH_SCORE_STATE;
  }
  return choice;
}

void paintGameOverScreen() {
  gb.display.setFontSize(2);
  gb.display.setColor(BROWN);
  gb.display.println("");
  gb.display.println("");
  gb.display.println("GAME OVER");

  gb.display.setFontSize(1);
  gb.display.setColor(WHITE);
  gb.display.println("");
  gb.display.println("");
  gb.display.println("(A) Try again");
  gb.display.println("(B) Menu");
}

void paintEndOfGame(const uint16_t * aTime) {
  gb.display.setFontSize(2);
  gb.display.setColor(BROWN);
  gb.display.println("");
  gb.display.println("");
  gb.display.println("TRY AGAIN");
  paintTimer(aTime);
  gb.display.setFontSize(1);
  gb.display.setColor(WHITE);
  
  gb.display.println("");
  gb.display.println("");
  gb.display.println("(A) Try again");
  gb.display.println("(B) Menu");
}

// Dessiner le jeu
void paint(Character &aCharacter, Platform * aSet, Object * aSetOfObjects, Timer &aTimer) {
  #if ! DEBUG_PLATFORMER
  paintBackground();
  #endif
  paintPlatforms(aSet);
  paintObjects(aSetOfObjects);
  paintHero(aCharacter);
  paintTimer(aTimer.valueOfTime);
}

// Dessiner le fond
void paintBackground() {
  gb.display.drawImage(0, 0, background);
}

// Dessiner le héro
void paintHero(Character &aCharacter) {
  int x = aCharacter.x - OVER_CENTER_X_HERO;
  int y = aCharacter.y - OVER_CENTER_Y_HERO;
  
  #if ! DEBUG_PLATFORMER // Mode debug inactif ===========================================
  
  if(aCharacter.haveKey) {
    if(aCharacter.toTheLeft) {
      // le personnage se déplace vers la gauche
  
      if(aCharacter.animation < INDEX_FOR_CHANGE_ANIMATION_HERO) {
        gb.display.drawImage(x, y, heroG1K);
      } else {
        gb.display.drawImage(x, y, heroG2K);
      }
      
    } else {
      // le personnage se déplace vers la droite
  
      if(aCharacter.animation < INDEX_FOR_CHANGE_ANIMATION_HERO) {
        gb.display.drawImage(x, y, heroD1K);
      } else {
        gb.display.drawImage(x, y, heroD2K);
      }
      
    }
  } else {
    if(aCharacter.toTheLeft) {
      // le personnage se déplace vers la gauche
  
      if(aCharacter.animation < INDEX_FOR_CHANGE_ANIMATION_HERO) {
        gb.display.drawImage(x, y, heroG1);
      } else {
        gb.display.drawImage(x, y, heroG2);
      }
      
    } else {
      // le personnage se déplace vers la droite
  
      if(aCharacter.animation < INDEX_FOR_CHANGE_ANIMATION_HERO) {
        gb.display.drawImage(x, y, heroD1);
      } else {
        gb.display.drawImage(x, y, heroD2);
      }
      
    }
  }
  // debug
  //gb.display.printf("%d,%d : %d", x, y, aCharacter.animation); // <<<<<<<<<<<<<<<<<<<<<<<<<<<<<
  
  #else // Mode debug actif ==============================================================

  paintBox(x, y, WIDTH_HERO, HEIGHT_HERO, aCharacter.haveKey ? color4HeroWithKey : (aCharacter.toTheLeft ? color4HeroL : color4HeroR) );

  #endif
}

// Dessiner toutes les plateformes
void paintPlatforms(Platform * aSet) {
  for(int i = 0 ; i < NB_OF_PLATFORMS ; i++) {
    paintPlatform(aSet[i]);
  }
}

// Dessiner une plateforme quelconque
void paintPlatform(Platform aPlatform) {
  int x = aPlatform.x - OVER_CENTER_X_PLATFORM;
  int y = aPlatform.y - OVER_CENTER_Y_PLATFORM;
  if(aPlatform.type == GROUND_TYPE) {
    x = aPlatform.x - OVER_CENTER_X_GROUND;
    y = aPlatform.y - OVER_CENTER_Y_GROUND;
  } else if(aPlatform.type == HILL_TYPE) {
    x = aPlatform.x - OVER_CENTER_X_HILL;
    y = aPlatform.y - OVER_CENTER_Y_HILL;
  }
  
  for(int i = 0 ; i < aPlatform.lengthPlatform ; i++) {

    switch(aPlatform.type) {
      case GROUND_TYPE: // on dessine le sol
        paintGround(x, y);
        x += WIDTH_GROUND;
      break;
      case HILL_TYPE: // on dessine la colline
        paintHill(i, aPlatform.lengthPlatform, x, y);
        x += WIDTH_HILL;
      break;
      default: // on dessine une plateforme
        paintPlatform(i, aPlatform.lengthPlatform, x, y, aPlatform.isGoThrough);
        x += WIDTH_PLATFORM;
    }
    
  }
  
}

// Dessiner une plateforme flottante
void paintPlatform(const int anIndex, const int aNbBlocks, const int aX, const int aY, const bool isGoThrough) {
  #if ! DEBUG_PLATFORMER // Mode debug inactif ===========================================
  
  if(anIndex == 0) {
    // si c'est le début de la plateforme
    // alors on dessine une plateforme droite
    gb.display.drawImage(aX, aY, platformLeft);
  } else if(anIndex == (aNbBlocks - 1)) {
    // si c'est la fin de la plateforme
    // alors on dessine une plateforme gauche
    gb.display.drawImage(aX, aY, platformRight);
  } else {
    // sinon on dessine une plateforme centrale
    gb.display.drawImage(aX, aY, platformMiddle);
  }
  #else // Mode debug actif ==============================================================

  paintBox(aX, aY, WIDTH_PLATFORM, HEIGHT_PLATFORM, (isGoThrough ? color4PlatformT : color4PlatformNotT));

  #endif
}

void paintHill(const int anIndex, const int aNbBlocks, const int aX, const int aY) {
  if(anIndex == 0) {
    gb.display.drawImage(aX, aY, hillLeft);
  } else if(anIndex == (aNbBlocks - 1)) {
    // si c'est la fin de la plateforme
    // alors on dessine une plateforme gauche
    gb.display.drawImage(aX, aY, hillRight);
  } else {
    // sinon on dessine une plateforme centrale
    gb.display.drawImage(aX, aY, hillMiddle2);
  }
}

// Dessiner le sol
void paintGround(const int aX, const int aY) {
  /*switch(random(0, 6)) {
    case 1:
      gb.display.drawImage(aX, aY, ground2);
    break;
    case 3:
      gb.display.drawImage(aX, aY, ground3);
    break;
    default:
      gb.display.drawImage(aX, aY, ground1);
  }*/
  #if ! DEBUG_PLATFORMER // Mode debug inactif ===========================================
  gb.display.drawImage(aX, aY, ground1);
  #else // Mode debug actif ==============================================================
  paintBox(aX, aY, WIDTH_GROUND, HEIGHT_GROUND, color4Ground);
  #endif
}

void paintObjects(Object * aSet) {
  for(int i = 0 ; i < NB_OF_OBJECTS ; i++) {
    paintObject(aSet[i]);
  }
}

void paintObject(Object anObject) {
  switch(anObject.type) {
    case KEY_OBJECT:
      paintKey(anObject.x, anObject.y, anObject.state);
    break;
    case DOOR_OBJECT:
      paintDoor(anObject.x, anObject.y, anObject.state);
    break;
    default:
      gb.display.setColor(RED);
      gb.display.println("Type obj inconnue");
  }
}

void paintKey(const int aX, const int aY, const int aState) {
  if(aState == KEY_ON_THE_PLATFORM) {
    #if ! DEBUG_PLATFORMER // Mode debug inactif =========================================
    gb.display.drawImage(aX - OVER_CENTER_X_KEY, aY - OVER_CENTER_Y_KEY, key);
    #else
    paintBox(aX - OVER_CENTER_X_KEY, aY - OVER_CENTER_Y_KEY, WIDTH_KEY, HEIGHT_KEY, color4Key);
    #endif
  }
}

void paintDoor(const int aX, const int aY, const int aState) {
  const int x = aX - OVER_CENTER_X_DOOR;
  const int y = aY - OVER_CENTER_Y_DOOR;
  #if ! DEBUG_PLATFORMER // Mode debug inactif ==========================================
  switch(aState) {
    case DOOR_BTW_OPEN:
      gb.display.drawImage(x, y, doorBtwOpen);
    break;
    case DOOR_OPEN:
      gb.display.drawImage(x, y, doorOpen);
    break;
    default:
      gb.display.drawImage(x, y, doorClosed);
  }
  #else // Mode debug actif =============================================================
  paintBox(x, y, WIDTH_DOOR, HEIGHT_DOOR, (aState == DOOR_BTW_OPEN ? color4DoorOpen : color4DoorClosed));
  #endif
}


void paintTimer(const uint16_t * aTime) {
  gb.display.setFontSize(1);
  gb.display.setColor(WHITE);
  
  uint16_t nbSeconds = aTime[SECONDS_NUMBER];
  if(nbSeconds < 10) {
    gb.display.print("0");
  }
  gb.display.printf("%d:", nbSeconds);
  gb.display.printf("%d", aTime[MILLISECONDS_NUMBER]);
}


#if DEBUG_PLATFORMER
void paintBox(const int aX, const int aY, const int aWidth, const int aHeight, const Color aColor) {
  gb.display.setColor(aColor);
  gb.display.fillRect(aX, aY, aWidth, aHeight);
}
#endif
